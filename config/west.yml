## config/west.yml
```yaml
manifest:
  remotes:
    - name: zmkfirmware
      url-base: https://github.com/zmkfirmware
    - name: bsalex
      url-base: https://github.com/bsalex
    # Additional modules containing boards/shields/custom code can be listed here as well
    # See https://docs.zephyrproject.org/3.2.0/develop/west/manifest.html#projects
  projects:
    - name: zmk
      remote: zmkfirmware
      revision: main
      import: app/west.yml
    - name: zmk-behavior-haptic-drv2605
      remote: bsalex
      revision: main
    - name: zmk-behavior-dynamic-macros
      remote: bsalex
      revision: main
  self:
    path: config
```
